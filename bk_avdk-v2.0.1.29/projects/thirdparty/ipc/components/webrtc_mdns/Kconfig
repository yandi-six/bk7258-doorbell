## bk_avdk-v2.0.1.29/projects/thirdparty/ipc/components/webrtc_mdns/Kconfig
```kconfig
menu "webrtc mdns"
	config WEBRTC_MDNS
		bool "Enable webrtc mdns"
		default n
endmenu
```

## bk_avdk-v2.0.1.29/projects/thirdparty/oldtest/components/webrtc_jpeg/Kconfig
```kconfig
menu "jpeg deocder"
	config WEBRTC_JPEG
		bool "Enable webrtc jpeg deocder"
		default n
endmenu
```

## bk_avdk-v2.0.1.29/projects/thirdparty/oldtest/components/webrtc_major/Kconfig
```kconfig
menu "webrtc major"
	config WEBRTC_MAJOR
		bool "Enable webrtc major"
		default n
endmenu
```

## bk_avdk-v2.0.1.29/projects/thirdparty/oldtest/components/webrtc_minor/Kconfig
```kconfig
menu "webrtc minor"
	config WEBRTC_MINOR
		bool "Enable webrtc minor"
		default n
endmenu
```

## bk_avdk-v2.0.1.29/projects/thirdparty/oldtest/components/webrtc_sdk/Kconfig
```kconfig
menu "WebrtcSDK"
	config WEBRTC_SDK
		bool "Enable Webrtc sdk"
		default n
endmenu
```

## bk_avdk-v2.0.1.29/projects/thirdparty/test/components/bk_peripheral/Kconfig
```kconfig
menu "bk peripheral"
	source "${ARMINO_AVDK_DIR}/projects/thirdparty/ipc/components/bk_peripheral/src/lcd/rgb/Kconfig"
	source "${ARMINO_AVDK_DIR}/projects/thirdparty/ipc/components/bk_peripheral/src/lcd/mcu/Kconfig"
	source "${ARMINO_AVDK_DIR}/projects/thirdparty/ipc/components/bk_peripheral/src/lcd/qspi/Kconfig"
	source "${ARMINO_AVDK_DIR}/projects/thirdparty/ipc/components/bk_peripheral/src/dvp/Kconfig"
	source "${ARMINO_AVDK_DIR}/projects/thirdparty/ipc/components/bk_peripheral/src/tp/Kconfig" 
endmenu
```

## bk_avdk-v2.0.1.29/projects/thirdparty/test/components/project_defs/Kconfig
```kconfig
menu "projectdefs"
	config PROJECT_DEFS
		bool "Enable project defs"
		default n
	config PSRAM_MEM_SLAB_USER_SIZE
		depends on PSRAM
		int "size of psram user need to use"
		default 102400

	config PSRAM_MEM_SLAB_AUDIO_SIZE
		depends on PSRAM
		int "size of psram audio need to use"
		default 102400

	config PSRAM_MEM_SLAB_ENCODE_SIZE
		depends on PSRAM
		int "size of psram encode function need to use"
		default 1433600

	config PSRAM_MEM_SLAB_DISPLAY_SIZE
		depends on PSRAM
		int "size of psram display need to use"
		default 5701632
	config BOARD
		bool "enable board"
		default n
endmenu
```

## bk_avdk-v2.0.1.29/projects/thirdparty/test/components/webrtc_avi/Kconfig
```kconfig
menu "webrtc avi"
	config WEBRTC_AVI
		bool "Enable webrtc avi"
		default n
endmenu
```

## bk_avdk-v2.0.1.29/projects/thirdparty/test/components/webrtc_mp4/Kconfig
```kconfig
menu "Webrtcmp4"
	config WEBRTC_MP4
		bool "Enable Webrtc MP4"
		default n
endmenu
```
